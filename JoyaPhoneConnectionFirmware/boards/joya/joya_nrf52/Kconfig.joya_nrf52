## JoyaPhoneConnectionFirmware/boards/joya/joya_nrf52/Kconfig.joya_nrf52
```kconfig
# Copyright (c) 2026 Joya
# SPDX-License-Identifier: Apache-2.0

config BOARD_JOYA_NRF52
	select SOC_NRF52832_QFAA
```

## JoyaPhoneConnectionFirmware/boards/joya/joya_nrf52/board.yml
```yaml
board:
  name: joya_nrf52
  full_name: Joya nRF52 PCB
  vendor: joya
  socs:
    - name: nrf52832

# For calling -b joya_nrf52/nrf52832
```
